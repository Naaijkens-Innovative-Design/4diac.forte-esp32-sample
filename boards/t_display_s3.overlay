/*
 * Copyright (c) 2023 Espressif Systems (Shanghai) Co., Ltd.
 *
 * SPDX-License-Identifier: Apache-2.0
 */

 /*
&flash0 {
	status = "okay";
	partitions {
		slot0_partition: partition@10000 {
			label = "image-0";
			reg = <0x00010000 0x00200000>;
		};

		/delete-node/ slot1_partition;
	};
};
*/

&wifi {
	status = "okay";
};

/ {
	fstab {
		compatible = "zephyr,fstab";
		lfs1: lfs1 {
			compatible = "zephyr,fstab,littlefs";
			mount-point = "/lfs1";
			partition = <&storage_partition>;
			automount;
			read-size = <16>;
			prog-size = <16>;
			cache-size = <64>;
			lookahead-size = <32>;
			block-cycles = <512>;
		};
	};
};